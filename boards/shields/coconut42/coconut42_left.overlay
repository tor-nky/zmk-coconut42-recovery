/*
 * Copyright (c) 2024 Satoru NAKAYA
 *
 * SPDX-License-Identifier: MIT
 */

#include "coconut42.dtsi"

&kscan0 {
    col-gpios
        = <&xiao_d 0 GPIO_ACTIVE_LOW>
        , <&xiao_d 1 GPIO_ACTIVE_LOW>
        , <&xiao_d 3 GPIO_ACTIVE_LOW>
        , <&xiao_d 10 GPIO_ACTIVE_LOW>
        , <&xiao_d 9 GPIO_ACTIVE_LOW>
        , <&xiao_d 8 GPIO_ACTIVE_LOW>
        ;
};
