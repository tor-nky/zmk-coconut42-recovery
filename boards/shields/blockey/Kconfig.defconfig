## boards/shields/blockey/Kconfig.defconfig
```kconfig
# Copyright (c) 2025 Satoru NAKAYA
# SPDX-License-Identifier: MIT

if SHIELD_BLOCKEY

config ZMK_KEYBOARD_NAME
    default "Blockey"

endif
```

## boards/shields/coconut42/Kconfig.defconfig
```kconfig
# Copyright (c) 2021 The ZMK Contributors
# SPDX-License-Identifier: MIT

if SHIELD_COCONUT42

config ZMK_KEYBOARD_NAME
    default "coconut42"

endif
```

## boards/shields/coconut42/Kconfig.shield
```kconfig
# Copyright (c) 2024 Satoru NAKAYA
# SPDX-License-Identifier: MIT

config SHIELD_COCONUT42_LEFT
   def_bool $(shields_list_contains,coconut42_left)

config SHIELD_COCONUT42_RIGHT
   def_bool $(shields_list_contains,coconut42_right)
```

## boards/shields/gpk60_46sgr/Kconfig.defconfig
```kconfig
# Copyright (c) 2021 The ZMK Contributors
# SPDX-License-Identifier: MIT

if SHIELD_GPK60_46SGR

config ZMK_KEYBOARD_NAME
    default "gpk60_46sgr"

endif
```

## boards/shields/gpk60_46sgr/Kconfig.shield
```kconfig
# Copyright (c) 2021 The ZMK Contributors
# SPDX-License-Identifier: MIT

config SHIELD_GPK60_46SGR
    def_bool $(shields_list_contains,gpk60_46sgr)
```

## boards/shields/pad2x3s/Kconfig.defconfig
```kconfig
# Copyright (c) 2024 Satoru NAKAYA
# SPDX-License-Identifier: MIT

if SHIELD_PAD2X3S_LEFT

config ZMK_KEYBOARD_NAME
    default "pad2x3s"

config ZMK_SPLIT_ROLE_CENTRAL
    default y

endif

if SHIELD_PAD2X3S_LEFT || SHIELD_PAD2X3S_RIGHT

config ZMK_SPLIT
    default y

endif
```

## boards/shields/pad2x3s/Kconfig.shield
```kconfig
# Copyright (c) 2024 Satoru NAKAYA
# SPDX-License-Identifier: MIT

config SHIELD_PAD2X3S_LEFT
    def_bool $(shields_list_contains,pad2x3s_left)

config SHIELD_PAD2X3S_RIGHT
    def_bool $(shields_list_contains,pad2x3s_right)
```

## boards/shields/test/Kconfig.defconfig
```kconfig
# Copyright (c) 2024 Satoru NAKAYA
# SPDX-License-Identifier: MIT

if SHIELD_TEST

config ZMK_KEYBOARD_NAME
    default "coconut42"

endif
```

## boards/shields/test/Kconfig.shield
```kconfig
# Copyright (c) 2024 Satoru NAKAYA
# SPDX-License-Identifier: MIT

config SHIELD_TEST
    def_bool $(shields_list_contains,coconut42)
```

## config/west.yml
```yaml
manifest:
  remotes:
    - name: zmkfirmware
      url-base: https://github.com/zmkfirmware
    - name: kot149
      url-base: https://github.com/kot149
    - name: caksoylar  # zmk-rgbled-widget
      url-base: https://github.com/caksoylar
    # - name: urob
    #   url-base: https://github.com/urob
    # - name: eswai # ここを追加
    #   url-base: https://github.com/eswai
    # - name: prospector
    #   url-base: https://github.com/t-ogura
  projects:
    - name: zmk
      remote: zmkfirmware
      revision: main
      import: app/west.yml
    - name: zmk-layout-shift
      remote: kot149
      revision: v1
    - name: zmk-rgbled-widget
      remote: caksoylar
      revision: main
    # - name: zmk-helpers
    #   remote: urob
    #   revision: main
    # - name: zmk-naginata # ここを追加
    #   remote: eswai
    #   revision: main
    # - name: prospector-zmk-module
    #   remote: prospector
    #   revision: v1.0.0
    #   path: modules/prospector-zmk-module
  self:
    path: config
```
